## Documentation/devicetree/bindings/input/microchip,at42qt2120.yaml
```yaml
# SPDX-License-Identifier: (GPL-2.0-only OR BSD-2-Clause)
%YAML 1.2
---
$id: http://devicetree.org/schemas/input/microchip,at42qt2120.yaml#
$schema: http://devicetree.org/meta-schemas/core.yaml#

title: Microchip AT42QT2120 12-key QTouch sensor

maintainers:
  - Andrei Mironenko <andrei.mironenko@gmail.com>

allOf:
  - $ref: input.yaml#

properties:
  compatible:
    const: microchip,at42qt2120

  reg:
    const: 0x1c

  interrupts:
    maxItems: 1
    description: Open-drain, active-low CHANGE output.

  reset-gpios:
    maxItems: 1
    description: GPIO connected to the active-low RESET pin.

  linux,keycodes:
    minItems: 1
    maxItems: 12
    description:
      Keycode for each key channel, starting at KEY0. Channels used as
      guard or proximity electrodes should be set to KEY_RESERVED.

  microchip,detect-threshold:
    $ref: /schemas/types.yaml#/definitions/uint8-array
    minItems: 12
    maxItems: 12
    description: Values written to the key detect threshold registers 16-27.

  microchip,key-control:
    $ref: /schemas/types.yaml#/definitions/uint8-array
    minItems: 12
    maxItems: 12
    description: Values written to the key control registers 28-39.

required:
  - compatible
  - reg
  - interrupts
  - linux,keycodes

unevaluatedProperties: false

examples:
  - |
    #include <dt-bindings/gpio/gpio.h>
    #include <dt-bindings/input/input.h>
    #include <dt-bindings/interrupt-controller/irq.h>

    i2c {
        #address-cells = <1>;
        #size-cells = <0>;

        touch-keys@1c {
            compatible = "microchip,at42qt2120";
            reg = <0x1c>;
            interrupt-parent = <&gpio1>;
            interrupts = <13 IRQ_TYPE_LEVEL_LOW>;
            reset-gpios = <&gpio2 9 GPIO_ACTIVE_LOW>;
            linux,keycodes = <KEY_RESERVED KEY_RESERVED KEY_F3 KEY_F4
                              KEY_F1 KEY_F2>;
        };
    };
```

## drivers/nfc/nxpnfc/Kconfig
```kconfig
#
# near field communication driver configuration
#
config NXP_NFC
	tristate
	help
	  NXP PN71xx/SNxxx core driver.
	  This is a driver based on the HCI NFC kernel layers and
	  will thus not work with NXP libnfc library.

config NXP_NFC_I2C
	tristate "NXP NCI based NFC I2C Slave Driver for SNxxx"
	depends on I2C
	default n
	select NXP_NFC
	help
	  This enables the NFC driver for SNxxx based devices.
	  This is for I2C connected version. NCI protocol logic
	  resides in the usermode and it has no other NFC dependencies.
	  If unsure, say N.

config NXP_NFC_SPI
	tristate "NXP NFC SPI Slave driver for PN71xx devices"
	depends on SPI
	default n
	select NXP_NFC
	help
	 This enables the NFC driver for PN71xx based devices.
	 This is for SPI connected version. NCI protocol logic
	 resides in the usermode and it has no other NFC dependencies.
	 If unsure, say N.
```

## drivers/usb/roles/Kconfig
```kconfig
# SPDX-License-Identifier: GPL-2.0

config USB_ROLE_SWITCH
	tristate "USB Role Switch Support"
	help
	  USB Role Switch is a device that can select the USB role - host or
	  device - for a USB port (connector). In most cases dual-role capable
	  USB controller will also represent the switch, but on some platforms
	  multiplexer/demultiplexer switch is used to route the data lines on
	  the USB connector between separate USB host and device controllers.

	  Say Y here if your USB connectors support both device and host roles.
	  To compile the driver as module, choose M here: the module will be
	  called roles.ko.

if USB_ROLE_SWITCH

config USB_ROLES_INTEL_XHCI
	tristate "Intel XHCI USB Role Switch"
	depends on ACPI && X86
	help
	  Driver for the internal USB role switch for switching the USB data
	  lines between the xHCI host controller and the dwc3 gadget controller
	  found on various Intel SoCs.

	  To compile the driver as a module, choose M here: the module will
	  be called intel-xhci-usb-role-switch.

config USB_ROLES_VBUS_FAULT_GPIO
	tristate "GPIO VBUS fault monitor for USB role switches"
	depends on GPIOLIB && OF
	help
	  Monitors the fault output of a VBUS power switch (over-current,
	  thermal shutdown, reverse voltage) and moves the USB role switch
	  out of host role, which turns VBUS off, when a fault is reported.
	  Used on boards with a dual-role port and no Type-C controller.

	  To compile the driver as a module, choose M here: the module will
	  be called usb-vbus-fault-gpio.

endif # USB_ROLE_SWITCH
```
